# PIC16HV753 register map
Vendor: Microchip
Architecture 16xxxx. Special function registers and configuration words.
Registers are 8-bit, read-write, reset 0x0 unless marked. A register's access mark holds for its fields unless they carry their own. Addresses are absolute, and some are shared; only a register's first bit layout is shown; lines under a group give offsets from that group; [hi:lo] are bit positions; {n}, {i} and the like mark numbered series; 'fields as' and 'values as' point back to an identical list; <NAME> marks a mode.

## Further device data
pins=1: Vdd; 2: RA5/T1CKI/CLKIN; 3: RA4/T1G/AN3/CLKOUT; 4: RA3/T1G/Vpp/MCLR; 5: RC5/COG1OUT0/CCP1; 6: RC4/COG1OUT1/C2OUT; 7: RC3/AN7/C1IN3-/C2IN3-; 8: RC2/SLPCIN/AN6/OPA1OUT/C1IN2-/C2IN2-; 9: RC1/OPA1IN-/AN5/C1IN1-/C2IN1-; 10: RC0/OPA1IN+/AN4/C2IN0+; 11: RA2/INT/C1OUT/T0CKI/AN2/COG1FLT; 12: RA1/C1IN0-/C2IN0-/AN1/VREF+/FVRIN/ICSPCLK; 13: RA0/C1IN0+/AN0/DACOUT/FVROUT/ICSPDAT; 14: Vss

## CONFIG — Configuration words, addresses in ProgramSpace
0x2007 CONFIG 14-bit reset 0x3FFF — CONFIGURATION WORD
  [13] DEBUG — Debug Mode Enable bit
    1=OFF (Debug mode disabled); 0=ON (Debug mode enabled)
  [12] CLKOUTEN — Clock Out Enable bit
    1=OFF (CLKOUT function disabled. CLKOUT pin acts as I/O); 0=ON (CLKOUT function enabled. CLKOUT pin is CLKOUT)
  [11:10] WRT — Flash Program Memory Self Write Enable bit
    3=OFF (Flash self-write protection off); 2=FOURTH (000h to 0FFh self-write protected); 1=HALF (000h to 1FFh self-write protected); 0=ALL (000h to 3FFh self-write protected)
  [9:8] BOREN — Brown-out Reset Enable bits
    3=EN (BOR enabled); 2=SLEEP_DIS (BOR enabled during operation and disabled in Sleep); 0b0x=DIS (BOR disabled)
  [6] CP — Code Protection bit
    1=OFF (Program memory code protection is disabled); 0=ON (Program memory code protection is enabled)
  [5] MCLRE — MCLR/VPP Pin Function Select bit
    1=ON (MCLR pin is MCLR function with internal weak pullup); 0=OFF (MCLR pin is alternate function)
  [4] PWRTE — Power-up Timer Enable bit
    1=OFF (Power-up Timer disabled); 0=ON (Power-up Timer enabled)
  [3] WDTE — Watchdog Timer Enable bit
    1=ON (Watchdog Timer enabled); 0=OFF (Watchdog Timer disabled)
  [0] FOSC0 — FOSC: Oscillator Selection bit
    1=EC (EC oscillator mode. CLKIN function on RA5/CLKIN); 0=INT (Internal oscillator mode. I/O function on RA5/CLKIN)
