# PIC16LF721 register map
Vendor: Microchip
Architecture 16xxxx. Special function registers and configuration words.
Registers are 8-bit, read-write, no defined reset value unless marked. A register's access mark holds for its fields unless they carry their own. Addresses are absolute, and some are shared; only a register's first bit layout is shown; lines under a group give offsets from that group; [hi:lo] are bit positions; {n}, {i} and the like mark numbered series; 'fields as' and 'values as' point back to an identical list; <NAME> marks a mode.

## Further device data
pins=1: Vdd; 2: RA5/T1CKI/CLKIN; 3: RA4/AN3/T1G/CLKOUT; 4: RA3/MCLR/Vpp; 5: RC5/CCP1; 6: RC4; 7: RC3/AN7; 8: RC6/AN8/SS; 9: RC7/AN9/SDO; 10: RB7/TX/CK; 11: RB6/SCK/SCL; 12: RB5/AN11/RX/DT; 13: RB4/AN10/SDI/SDA; 14: RC2/AN6; 15: RC1/AN5; 16: RC0/AN4; 17: RA2/AN2/T0CKI/INT; 18: RA1/AN1/ICSPCLK/ICDCLK; 19: RA0/AN0/ICSPDAT/ICDDAT; 20: Vss

## CONFIG — Configuration words, addresses in ProgramSpace
0x2007 CONFIG1 14-bit reset 0x3FFF
  [12] PLLEN — INTOSC PLLEN Enable Bit
    0=OFF (INTOSC Frequency is 500 kHz); 1=ON (INTOSC Frequency is 16 MHz (32x))
  [9:8] BOREN — Brown-out Reset Enable bits
    0=OFF (Brown-out Reset disabled (Preconditioned State)); 2=NSLEEP (Brown-out Reset enabled during operation and disabled in Sleep); 3=ON (Brown-out Reset enabled)
  [6] CP — Flash Program Memory Code Protection bit
    0=ON (0000h to 0FFFh code protection on); 1=OFF (Code protection off)
  [5] MCLRE — RA3/MCLR/VPP Pin Function Select bit
    1=ON (RA3/MCLR/VPP pin function is MCLR; Weak pull-up enabled.); 0=OFF (RA3/MCLR/VPP pin function is digital input; MCLR internally disabled; Weak pull-up disabled)
  [4] PWRTE — Power-up Timer Enable bit
    0=ON (PWRT enabled); 1=OFF (PWRT disabled)
  [3] WDTE — Watchdog Timer Enable bit
    0=OFF (WDT disabled); 1=ON (WDT enabled)
  [1:0] FOSC — Oscillator Selection bits
    3=ECCLK (EC oscillator: CLKO function on RA4/CLKO pin, CLKI on RA5/CLKI); 2=ECIO (EC oscillator: I/O function on RA4/CLKO pin, CLKI on RA5/CLKI); 1=INTOSCCLK (INTOSC oscillator: CLKO function on RA4/CLKO pin, I/O function on RA5/CLKI); 0=INTOSCIO (INTOSCIO oscillator: I/O function on RA4/CLKO pin, I/O function on RA5/CLKI)
0x2008 CONFIG2 reset 0xFFFF
  [1:0] WRTEN — Flash memory self-write protection bits
    3=OFF (Write protection off); 2=BOOT (0h to 1FFh of flash memory write protected, 200h to FFFh may be modified); 1=HALF (0h to 7FFh of flash memory write protected, 800h to FFFh may be modified); 0=FULL (0h to FFFh of flash memory write protected, no address may be modified)
