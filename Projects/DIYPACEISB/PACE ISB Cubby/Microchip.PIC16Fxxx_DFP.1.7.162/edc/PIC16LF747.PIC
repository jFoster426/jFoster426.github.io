# PIC16LF747 register map
Vendor: Microchip
Architecture 16xxxx. Special function registers and configuration words.
Registers are 8-bit, read-write, no defined reset value unless marked. A register's access mark holds for its fields unless they carry their own. Addresses are absolute, and some are shared; only a register's first bit layout is shown; lines under a group give offsets from that group; [hi:lo] are bit positions; {n}, {i} and the like mark numbered series; 'fields as' and 'values as' point back to an identical list; <NAME> marks a mode.

## Further device data
pins=1: MCLR/Vpp/RE3; 2: RA0/AN0; 3: RA1/AN1; 4: RA2/AN2/Vref-/CVref; 5: RA3/AN3/Vref+; 6: RA4/T0CKI/C1OUT; 7: RA5/AN4/LVDIN/SS/C2OUT; 8: RE0/RD/AN5; 9: RE1/WR/AN6; 10: RE2/CS/AN7; 11: Vdd; 12: Vss; 13: OSC1/CLKI/RA7; 14: OSC2/CLKO/RA6; 15: RC0/T1OSO/T1CKI; 16: RC1/T1OSI/CCP2; 17: RC2/CCP1; 18: RC3/SCK/SCL; 19: RD0/PSP0; 20: RD1/PSP1; 21: RD2/PSP2; 22: RD3/PSP3; 23: RC4/SDI/SDA; 24: RC5/SDO; 25: RC6/TX/CK; 26: RC7/RX/DT; 27: RD4/PSP4; 28: RD5/PSP5; 29: RD6/PSP6; 30: RD7/PSP7; 31: Vss; 32: Vdd; 33: RB0/INT/AN12; 34: RB1/AN10; 35: RB2/AN8; 36: RB3/CCP2/AN9; 37: RB4/AN11; 38: RB5/AN13/CCP3; 39: RB6/PGC; 40: RB7/PGD

## CONFIG — Configuration words, addresses in ProgramSpace
0x2007 CONFIG1 14-bit reset 0x3FFF
  [13] CP — Flash Program Memory Code Protection bits
    1=OFF (Code protection off); 0=ON (0000h to 0FFFh code-protected)
  [12] CCP2MX — CCP2 Multiplex bit
    1=RC1 (CCP2 is on RC1); 0=RB3 (CCP2 is on RB3)
  [11] DEBUG — In-Circuit Debugger Mode bit
    1=OFF (In-Circuit Debugger disabled, RB6 and RB7 are general purpose I/O pins); 0=ON (In-Circuit Debugger enabled, RB6 and RB7 are dedicated to the debugger)
  [8:7] BORV — Brown-out Reset Voltage bits
    3=VBOR set to 2.0V; 2=VBOR set to 2.7V; 1=VBOR set to 4.2V; 0=VBOR set to 4.5V
  [6] BOREN — Brown-out Reset Enable bit
    1=ON (Enabled); 0=OFF (Disabled)
  [5] MCLRE — MCLR/VPP/RE3 Pin Function Select bit
    1=ON (MCLR/VPP/RE3 pin function is MCLR); 0=OFF (MCLR/VPP/RE3 pin function is digital input only, MCLR gated to '1')
  [3] PWRTE — Power-up Timer Enable bit
    1=OFF (PWRT disabled); 0=ON (PWRT enabled)
  [2] WDTE — Watchdog Timer Enable bit
    1=ON (WDT enabled); 0=OFF (WDT disabled)
  [4:0] FOSC — Oscillator Selection bits
    0b1xx11=EXTRCCLK (EXTRC oscillator; CLKO function on OSC2/CLKO/RA6); 0b1xx10=EXTRCIO (EXTRC oscillator; port I/O function on OSC2/CLKO/RA6); 0b1xx01=INTOSCCLK (INTRC oscillator; CLKO function on OSC2/CLKO/RA6 and port I/O function on OSC1/CLKI/RA7); 0b1xx00=INTOSCIO (INTRC oscillator; port I/O function on OSC1/CLKI/RA7 and OSC2/CLKO/RA6); 0b0xx11=EC (EXTCLK; port I/O function on OSC2/CLKO/RA6); 0b0xx10=HS (HS oscillator); 0b0xx01=XT (XT oscillator); 0b0xx00=LP (LP oscillator)
0x2008 CONFIG2 14-bit reset 0x3FFF
  [6] BORSEN — Brown-out Reset Software Enable bit
    1=ON (Enabled); 0=OFF (Disabled)
  [1] IESO — Internal External Switchover bit
    1=ON (Internal External Switchover mode enabled); 0=OFF (Internal External Switchover mode disabled)
  [0] FCMEN — Fail-Safe Clock Monitor Enable bit
    1=ON (Fail-Safe Clock Monitor enabled); 0=OFF (Fail-Safe Clock Monitor disabled)
