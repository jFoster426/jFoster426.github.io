# PIC16F707 register map
Vendor: Microchip
Architecture 16xxxx. Special function registers and configuration words.
Registers are 8-bit, read-write, reset 0x0 unless marked. A register's access mark holds for its fields unless they carry their own. Addresses are absolute, and some are shared; only a register's first bit layout is shown; lines under a group give offsets from that group; [hi:lo] are bit positions; {n}, {i} and the like mark numbered series; 'fields as' and 'values as' point back to an identical list; <NAME> marks a mode.

## Further device data
pins=1: RE3/MCLR/Vpp; 2: RA0/AN0/SS/Vcap; 3: RA1/AN1/CPSA0; 4: RA2/AN2/CPSA1/DACOUT; 5: RA3/AN3/Vref/CPSA2; 6: RA4/CPSA3/T0CKI/TACKI; 7: RA5/AN4/CPSA4/SS/Vcap; 8: RE0/AN5/CPSA5; 9: RE1/AN6/CPSA6; 10: RE2/AN7/CPSA7; 11: Vdd; 12: Vss; 13: RA7/CPSB0/OSC1/CLKIN; 14: RA6/CPSB1/OSC2/CLKOUT/Vcap; 15: RC0/CPSB2/T1OSO/T1CKI; 16: RC1/CPSB3/T1OSI/CCP2; 17: RC2/CPSB4/CCP1/TBCKI; 18: RC3/SCK/SCL; 19: RD0/CPSB5/T3G; 20: RD1/CPSB6; 21: RD2/CPSB7; 22: RD3/CPSA8; 23: RC4/SDI/SDA; 24: RC5/CPSA9/SDO; 25: RC6/CPSA10/TX/CK; 26: RC7/CPSA11/RX/DT; 27: RD4/CPSA12; 28: RD5/CPSA13; 29: RD6/CPSA14; 30: RD7/CPSA15; 31: Vss; 32: Vdd; 33: RB0/AN12/CPSB8/INT; 34: RB1/AN10/CPSB9; 35: RB2/AN8/CPSB10; 36: RB3/AN9/CPSB11/CCP2; 37: RB4/AN11/CPSB12; 38: RB5/AN13/CPSB13/T1G/T3CKI; 39: RB6/CPSB14/ICSPCLK/ICDCLK; 40: RB7/CPSB15/ICSPDAT/ICDDAT

## CONFIG — Configuration words, addresses in ProgramSpace
0x2007 CONFIG 14-bit reset 0x3FFF
  [12] PLLEN — INTOSC PLLEN Enable Bit
    1=ON (INTOSC Frequency is 16 MHz (32x)); 0=OFF (INTOSC Frequency is 500 kHz)
  [10] BORV — Brown-out Reset Voltage Selection bit
    1=Brown-out Reset Voltage (VBOR) set to 1.9 V nominal; 0=Brown-out Reset Voltage (VBOR) set to 2.5 V nominal
  [9:8] BOREN — Brown-out Reset Selection bits
    3=ON (BOR enabled); 2=NSLEEP (BOR enabled during operation and disabled in Sleep); 1=OFF (BOR disabled (Preconditioned State)); 0=OFF (BOR disabled (Preconditioned State))
  [6] CP — Code Protection bit
    1=OFF (Program memory code protection is disabled); 0=ON (Program memory code protection is enabled)
  [5] MCLRE — RE3/MCLR Pin Function Select bit
    1=ON (RE3/MCLR pin function is MCLR); 0=OFF (RE3/MCLR pin function is digital input, MCLR internally tied to VDD)
  [4] PWRTE — Power-up Timer Enable bit
    1=OFF (PWRT disabled); 0=ON (PWRT enabled)
  [3] WDTE — Watchdog Timer Enable bit
    1=ON (WDT enabled); 0=OFF (WDT disabled and can be enabled by SWDTEN bit of the WDTCON register)
  [2:0] FOSC — Oscillator Selection bits
    7=EXTRC (RC oscillator: CLKOUT function on RA6/OSC2/CLKOUT pin, RC on RA7/OSC1/CLKIN); 6=EXTRCIO (RCIO oscillator: I/O function on RA6/OSC2/CLKOUT pin, RC on RA7/OSC1/CLKIN); 5=INTOSC (INTOSC oscillator: CLKOUT function on RA6/OSC2/CLKOUT pin, I/O function on RA7/OSC1/CLKIN); 4=INTOSCIO (INTOSCIO oscillator: I/O function on RA6/OSC2/CLKOUT and RA7/OSC1/CLKIN pins); 3=EC_OSC (EC oscillator: I/O function on RA6/OSC2/CLKOUT pin, CLKIN on RA7/OSC1/CLKIN); 2=HS_OSC (HS oscillator: High Speed crystal/resonator on RA6/OSC2/CLKOUT and RA7/OSC1/CLKIN); 1=XT_OSC (XT oscillator: Crystal/resonator on RA6/OSC2/CLKIN and RA7/OSC1/CLKIN); 0=LP_OSC (LP oscillator: Low-power crystal on RA6/OSC2/CLKOUT and RA7/OSC1/CLKIN)
0x2008 CONFIG2 reset 0xFFFF
  [5:4] VCAPEN — Voltage Regulator Capacitor Enable bits
    3=OFF (All VCAP pin functions are disabled); 2=RA6 (VCAP functionality is enabled on RA6); 1=RA5 (VCAP functionality is enabled on RA5); 0=RA0 (VCAP functionality is enabled on RA0)
