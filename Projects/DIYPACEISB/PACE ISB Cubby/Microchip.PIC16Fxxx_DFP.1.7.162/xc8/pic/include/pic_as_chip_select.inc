// Generated 26/03/2025 GMT

/*
 * Copyright © 2025, Microchip Technology Inc. and its subsidiaries ("Microchip")
 * All rights reserved.
 * 
 * This software is developed by Microchip Technology Inc. and its subsidiaries ("Microchip").
 * 
 * Redistribution and use in source and binary forms, with or without modification, are
 * permitted provided that the following conditions are met:
 * 
 *     1. Redistributions of source code must retain the above copyright notice, this list of
 *        conditions and the following disclaimer.
 * 
 *     2. Redistributions in binary form must reproduce the above copyright notice, this list
 *        of conditions and the following disclaimer in the documentation and/or other
 *        materials provided with the distribution. Publication is not required when
 *        this file is used in an embedded application.
 * 
 *     3. Microchip's name may not be used to endorse or promote products derived from this
 *        software without specific prior written permission.
 * 
 * THIS SOFTWARE IS PROVIDED BY MICROCHIP "AS IS" AND ANY EXPRESS OR IMPLIED WARRANTIES,
 * INCLUDING, BUT NOT LIMITED TO, THE IMPLIED WARRANTIES OF MERCHANTABILITY AND FITNESS FOR
 * PURPOSE ARE DISCLAIMED.  IN NO EVENT SHALL MICROCHIP BE LIABLE FOR ANY DIRECT, INDIRECT,
 * INCIDENTAL, SPECIAL, EXEMPLARY, OR CONSEQUENTIAL DAMAGES (INCLUDING BUT NOT LIMITED TO
 * PROCUREMENT OF SUBSTITUTE GOODS OR SERVICES; LOSS OF USE, DATA OR PROFITS; OR BUSINESS
 * INTERRUPTION) HOWSOEVER CAUSED AND ON ANY THEORY OF LIABILITY, WHETHER IN CONTRACT, STRICT
 * LIABILITY, OR TORT (INCLUDING NEGLIGENCE OR OTHERWISE) ARISING IN ANY WAY OUT OF THE USE OF
 * THIS SOFTWARE, EVEN IF ADVISED OF THE POSSIBILITY OF SUCH DAMAGE.
 */

#ifndef _PIC_AS_CHIP_SELECT_INC_
#define _PIC_AS_CHIP_SELECT_INC_

#define _HEADER_NOT_FOUND

#ifdef _16F505
#include <pic16f505.inc>
#undef _HEADER_NOT_FOUND
#endif

#ifdef _16F506
#include <pic16f506.inc>
#undef _HEADER_NOT_FOUND
#endif

#ifdef _16F526
#include <pic16f526.inc>
#undef _HEADER_NOT_FOUND
#endif

#ifdef _16F527
#include <pic16f527.inc>
#undef _HEADER_NOT_FOUND
#endif

#ifdef _16F54
#include <pic16f54.inc>
#undef _HEADER_NOT_FOUND
#endif

#ifdef _16F57
#include <pic16f57.inc>
#undef _HEADER_NOT_FOUND
#endif

#ifdef _16F570
#include <pic16f570.inc>
#undef _HEADER_NOT_FOUND
#endif

#ifdef _16F59
#include <pic16f59.inc>
#undef _HEADER_NOT_FOUND
#endif

#ifdef _16F610
#include <pic16f610.inc>
#undef _HEADER_NOT_FOUND
#endif

#ifdef _16F616
#include <pic16f616.inc>
#undef _HEADER_NOT_FOUND
#endif

#ifdef _16F627
#include <pic16f627.inc>
#undef _HEADER_NOT_FOUND
#endif

#ifdef _16F627A
#include <pic16f627a.inc>
#undef _HEADER_NOT_FOUND
#endif

#ifdef _16F628
#include <pic16f628.inc>
#undef _HEADER_NOT_FOUND
#endif

#ifdef _16F628A
#include <pic16f628a.inc>
#undef _HEADER_NOT_FOUND
#endif

#ifdef _16F630
#include <pic16f630.inc>
#undef _HEADER_NOT_FOUND
#endif

#ifdef _16F631
#include <pic16f631.inc>
#undef _HEADER_NOT_FOUND
#endif

#ifdef _16F636
#include <pic16f636.inc>
#undef _HEADER_NOT_FOUND
#endif

#ifdef _16F639
#include <pic16f639.inc>
#undef _HEADER_NOT_FOUND
#endif

#ifdef _16F648A
#include <pic16f648a.inc>
#undef _HEADER_NOT_FOUND
#endif

#ifdef _16F676
#include <pic16f676.inc>
#undef _HEADER_NOT_FOUND
#endif

#ifdef _16F677
#include <pic16f677.inc>
#undef _HEADER_NOT_FOUND
#endif

#ifdef _16F684
#include <pic16f684.inc>
#undef _HEADER_NOT_FOUND
#endif

#ifdef _16F685
#include <pic16f685.inc>
#undef _HEADER_NOT_FOUND
#endif

#ifdef _16F687
#include <pic16f687.inc>
#undef _HEADER_NOT_FOUND
#endif

#ifdef _16F688
#include <pic16f688.inc>
#undef _HEADER_NOT_FOUND
#endif

#ifdef _16F689
#include <pic16f689.inc>
#undef _HEADER_NOT_FOUND
#endif

#ifdef _16F690
#include <pic16f690.inc>
#undef _HEADER_NOT_FOUND
#endif

#ifdef _16F707
#include <pic16f707.inc>
#undef _HEADER_NOT_FOUND
#endif

#ifdef _16F716
#include <pic16f716.inc>
#undef _HEADER_NOT_FOUND
#endif

#ifdef _16F72
#include <pic16f72.inc>
#undef _HEADER_NOT_FOUND
#endif

#ifdef _16F720
#include <pic16f720.inc>
#undef _HEADER_NOT_FOUND
#endif

#ifdef _16F721
#include <pic16f721.inc>
#undef _HEADER_NOT_FOUND
#endif

#ifdef _16F722
#include <pic16f722.inc>
#undef _HEADER_NOT_FOUND
#endif

#ifdef _16F722A
#include <pic16f722a.inc>
#undef _HEADER_NOT_FOUND
#endif

#ifdef _16F723
#include <pic16f723.inc>
#undef _HEADER_NOT_FOUND
#endif

#ifdef _16F723A
#include <pic16f723a.inc>
#undef _HEADER_NOT_FOUND
#endif

#ifdef _16F724
#include <pic16f724.inc>
#undef _HEADER_NOT_FOUND
#endif

#ifdef _16F726
#include <pic16f726.inc>
#undef _HEADER_NOT_FOUND
#endif

#ifdef _16F727
#include <pic16f727.inc>
#undef _HEADER_NOT_FOUND
#endif

#ifdef _16F73
#include <pic16f73.inc>
#undef _HEADER_NOT_FOUND
#endif

#ifdef _16F737
#include <pic16f737.inc>
#undef _HEADER_NOT_FOUND
#endif

#ifdef _16F74
#include <pic16f74.inc>
#undef _HEADER_NOT_FOUND
#endif

#ifdef _16F747
#include <pic16f747.inc>
#undef _HEADER_NOT_FOUND
#endif

#ifdef _16F753
#include <pic16f753.inc>
#undef _HEADER_NOT_FOUND
#endif

#ifdef _16F76
#include <pic16f76.inc>
#undef _HEADER_NOT_FOUND
#endif

#ifdef _16F767
#include <pic16f767.inc>
#undef _HEADER_NOT_FOUND
#endif

#ifdef _16F77
#include <pic16f77.inc>
#undef _HEADER_NOT_FOUND
#endif

#ifdef _16F777
#include <pic16f777.inc>
#undef _HEADER_NOT_FOUND
#endif

#ifdef _16F785
#include <pic16f785.inc>
#undef _HEADER_NOT_FOUND
#endif

#ifdef _16F818
#include <pic16f818.inc>
#undef _HEADER_NOT_FOUND
#endif

#ifdef _16F819
#include <pic16f819.inc>
#undef _HEADER_NOT_FOUND
#endif

#ifdef _16F83
#include <pic16f83.inc>
#undef _HEADER_NOT_FOUND
#endif

#ifdef _16F84
#include <pic16f84.inc>
#undef _HEADER_NOT_FOUND
#endif

#ifdef _16F84A
#include <pic16f84a.inc>
#undef _HEADER_NOT_FOUND
#endif

#ifdef _16F87
#include <pic16f87.inc>
#undef _HEADER_NOT_FOUND
#endif

#ifdef _16F870
#include <pic16f870.inc>
#undef _HEADER_NOT_FOUND
#endif

#ifdef _16F871
#include <pic16f871.inc>
#undef _HEADER_NOT_FOUND
#endif

#ifdef _16F872
#include <pic16f872.inc>
#undef _HEADER_NOT_FOUND
#endif

#ifdef _16F873
#include <pic16f873.inc>
#undef _HEADER_NOT_FOUND
#endif

#ifdef _16F873A
#include <pic16f873a.inc>
#undef _HEADER_NOT_FOUND
#endif

#ifdef _16F874
#include <pic16f874.inc>
#undef _HEADER_NOT_FOUND
#endif

#ifdef _16F874A
#include <pic16f874a.inc>
#undef _HEADER_NOT_FOUND
#endif

#ifdef _16F876
#include <pic16f876.inc>
#undef _HEADER_NOT_FOUND
#endif

#ifdef _16F876A
#include <pic16f876a.inc>
#undef _HEADER_NOT_FOUND
#endif

#ifdef _16F877
#include <pic16f877.inc>
#undef _HEADER_NOT_FOUND
#endif

#ifdef _16F877A
#include <pic16f877a.inc>
#undef _HEADER_NOT_FOUND
#endif

#ifdef _16F88
#include <pic16f88.inc>
#undef _HEADER_NOT_FOUND
#endif

#ifdef _16F882
#include <pic16f882.inc>
#undef _HEADER_NOT_FOUND
#endif

#ifdef _16F883
#include <pic16f883.inc>
#undef _HEADER_NOT_FOUND
#endif

#ifdef _16F884
#include <pic16f884.inc>
#undef _HEADER_NOT_FOUND
#endif

#ifdef _16F886
#include <pic16f886.inc>
#undef _HEADER_NOT_FOUND
#endif

#ifdef _16F887
#include <pic16f887.inc>
#undef _HEADER_NOT_FOUND
#endif

#ifdef _16F913
#include <pic16f913.inc>
#undef _HEADER_NOT_FOUND
#endif

#ifdef _16F914
#include <pic16f914.inc>
#undef _HEADER_NOT_FOUND
#endif

#ifdef _16F916
#include <pic16f916.inc>
#undef _HEADER_NOT_FOUND
#endif

#ifdef _16F917
#include <pic16f917.inc>
#undef _HEADER_NOT_FOUND
#endif

#ifdef _16F946
#include <pic16f946.inc>
#undef _HEADER_NOT_FOUND
#endif

#ifdef _16HV540
#include <pic16hv540.inc>
#undef _HEADER_NOT_FOUND
#endif

#ifdef _16HV610
#include <pic16hv610.inc>
#undef _HEADER_NOT_FOUND
#endif

#ifdef _16HV616
#include <pic16hv616.inc>
#undef _HEADER_NOT_FOUND
#endif

#ifdef _16HV753
#include <pic16hv753.inc>
#undef _HEADER_NOT_FOUND
#endif

#ifdef _16HV785
#include <pic16hv785.inc>
#undef _HEADER_NOT_FOUND
#endif

#ifdef _16LF627
#include <pic16lf627.inc>
#undef _HEADER_NOT_FOUND
#endif

#ifdef _16LF627A
#include <pic16lf627a.inc>
#undef _HEADER_NOT_FOUND
#endif

#ifdef _16LF628
#include <pic16lf628.inc>
#undef _HEADER_NOT_FOUND
#endif

#ifdef _16LF628A
#include <pic16lf628a.inc>
#undef _HEADER_NOT_FOUND
#endif

#ifdef _16LF648A
#include <pic16lf648a.inc>
#undef _HEADER_NOT_FOUND
#endif

#ifdef _16LF707
#include <pic16lf707.inc>
#undef _HEADER_NOT_FOUND
#endif

#ifdef _16LF720
#include <pic16lf720.inc>
#undef _HEADER_NOT_FOUND
#endif

#ifdef _16LF721
#include <pic16lf721.inc>
#undef _HEADER_NOT_FOUND
#endif

#ifdef _16LF722
#include <pic16lf722.inc>
#undef _HEADER_NOT_FOUND
#endif

#ifdef _16LF722A
#include <pic16lf722a.inc>
#undef _HEADER_NOT_FOUND
#endif

#ifdef _16LF723
#include <pic16lf723.inc>
#undef _HEADER_NOT_FOUND
#endif

#ifdef _16LF723A
#include <pic16lf723a.inc>
#undef _HEADER_NOT_FOUND
#endif

#ifdef _16LF724
#include <pic16lf724.inc>
#undef _HEADER_NOT_FOUND
#endif

#ifdef _16LF726
#include <pic16lf726.inc>
#undef _HEADER_NOT_FOUND
#endif

#ifdef _16LF727
#include <pic16lf727.inc>
#undef _HEADER_NOT_FOUND
#endif

#ifdef _16LF73
#include <pic16lf73.inc>
#undef _HEADER_NOT_FOUND
#endif

#ifdef _16LF74
#include <pic16lf74.inc>
#undef _HEADER_NOT_FOUND
#endif

#ifdef _16LF747
#include <pic16lf747.inc>
#undef _HEADER_NOT_FOUND
#endif

#ifdef _16LF76
#include <pic16lf76.inc>
#undef _HEADER_NOT_FOUND
#endif

#ifdef _16LF767
#include <pic16lf767.inc>
#undef _HEADER_NOT_FOUND
#endif

#ifdef _16LF77
#include <pic16lf77.inc>
#undef _HEADER_NOT_FOUND
#endif

#ifdef _16LF777
#include <pic16lf777.inc>
#undef _HEADER_NOT_FOUND
#endif

#ifdef _16LF818
#include <pic16lf818.inc>
#undef _HEADER_NOT_FOUND
#endif

#ifdef _16LF819
#include <pic16lf819.inc>
#undef _HEADER_NOT_FOUND
#endif

#ifdef _16LF83
#include <pic16lf83.inc>
#undef _HEADER_NOT_FOUND
#endif

#ifdef _16LF84
#include <pic16lf84.inc>
#undef _HEADER_NOT_FOUND
#endif

#ifdef _16LF84A
#include <pic16lf84a.inc>
#undef _HEADER_NOT_FOUND
#endif

#ifdef _16LF87
#include <pic16lf87.inc>
#undef _HEADER_NOT_FOUND
#endif

#ifdef _16LF870
#include <pic16lf870.inc>
#undef _HEADER_NOT_FOUND
#endif

#ifdef _16LF871
#include <pic16lf871.inc>
#undef _HEADER_NOT_FOUND
#endif

#ifdef _16LF872
#include <pic16lf872.inc>
#undef _HEADER_NOT_FOUND
#endif

#ifdef _16LF873
#include <pic16lf873.inc>
#undef _HEADER_NOT_FOUND
#endif

#ifdef _16LF873A
#include <pic16lf873a.inc>
#undef _HEADER_NOT_FOUND
#endif

#ifdef _16LF874
#include <pic16lf874.inc>
#undef _HEADER_NOT_FOUND
#endif

#ifdef _16LF874A
#include <pic16lf874a.inc>
#undef _HEADER_NOT_FOUND
#endif

#ifdef _16LF876
#include <pic16lf876.inc>
#undef _HEADER_NOT_FOUND
#endif

#ifdef _16LF876A
#include <pic16lf876a.inc>
#undef _HEADER_NOT_FOUND
#endif

#ifdef _16LF877
#include <pic16lf877.inc>
#undef _HEADER_NOT_FOUND
#endif

#ifdef _16LF877A
#include <pic16lf877a.inc>
#undef _HEADER_NOT_FOUND
#endif

#ifdef _16LF88
#include <pic16lf88.inc>
#undef _HEADER_NOT_FOUND
#endif

#ifdef _TEST_CHIP_
#undef _HEADER_NOT_FOUND
#endif

#ifdef _HEADER_NOT_FOUND
#error Device-specific header could not be found for target chip
#endif

#endif // _PIC_AS_CHIP_SELECT_INC_
